//**************************************************************//
//  Adapted from 
//****************************************************************
#include <PCM.h>

//Pin connected to ST_CP of 74HC595
int latchPin = 8;
//Pin connected to SH_CP of 74HC595
int clockPin = 12;
//Pin connected to DS of 74HC595
int dataPin = 10;
//Pin connected to switch
int switchPin = 2;
//Flag to start sequence
int startSequence = 0;

//holders for infromation you're going to pass to shifting function
byte dataRED;
byte dataGREEN;
byte dataArrayRED[10];
byte dataArrayGREEN[10];

const unsigned char sample[] PROGMEM = {
  137, 137, 136, 135, 134, 134, 136, 137, 135, 131, 130, 131,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 130, 
};

void setup() {
  //set pins to output because they are addressed in the main loop
  pinMode(latchPin, OUTPUT);
  Serial.begin(9600);

  //Arduino doesn't seem to have a way to write binary straight into the code 
  //so these values are in HEX.  Decimal would have been fine, too. 
  dataArrayRED[0] = 0x01; //00000001
  dataArrayRED[1] = 0x02; //00000010
  dataArrayRED[2] = 0x04; //00000100
  dataArrayRED[3] = 0x08; //00001000
  dataArrayRED[4] = 0x10; //00010000
  dataArrayRED[5] = 0x20; //00100000
  dataArrayRED[6] = 0x40; //01000000
  dataArrayRED[7] = 0x80; //10000000
}

void loop() {
  
  // Trigger firecracker LED and sound sequence when button is pressed
  if (digitalRead(switchPin) == HIGH) {
    delay(1000);
    startSequence = 1; 
  }
  
  if (startSequence == 1) {
    for (int j = 0; j < 8; j++) {
      // Play audio only after 2 iterations
      if (j % 3 == 0) {
        startPlayback(sample, sizeof(sample));
      }
      
      //load the light sequence you want from array
      dataRED = dataArrayRED[j];
  
      //ground latchPin and hold low for as long as you are transmitting
      digitalWrite(latchPin, 0);
      //move 'em out
      shiftOut(dataPin, clockPin, dataRED);
      //shiftOut(dataPin, clockPin, dataRED);
      //return the latch pin high to signal chip that it 
      digitalWrite(latchPin, 1);
      delay(500);
      
      //ground latchPin and hold low for as long as you are transmitting
      digitalWrite(latchPin, 0);
      //move 'em out
      shiftOut(dataPin, clockPin, dataRED);
      //shiftOut(dataPin, clockPin, dataRED);
      //return the latch pin high to signal chip that it 
      //no longer needs to listen for information
      digitalWrite(latchPin, 1);
      delay(500);
    }
    
    //function that blinks all the LEDs
    //gets passed the number of blinks and the pause time
    startPlayback(sample, sizeof(sample)/4);
    blinkAll_2Bytes(2,200);
    
    startSequence = 0;
  }
}



// the heart of the program
void shiftOut(int myDataPin, int myClockPin, byte myDataOut) {
  // This shifts 8 bits out MSB first, 
  //on the rising edge of the clock,
  //clock idles low

  //internal function setup
  int i=0;
  int pinState;
  pinMode(myClockPin, OUTPUT);
  pinMode(myDataPin, OUTPUT);

  //clear everything out just in case to
  //prepare shift register for bit shifting
  digitalWrite(myDataPin, 0);
  digitalWrite(myClockPin, 0);

  //for each bit in the byte myDataOut�
  //NOTICE THAT WE ARE COUNTING DOWN in our for loop
  //This means that %00000001 or "1" will go through such
  //that it will be pin Q0 that lights. 
  for (i=7; i>=0; i--)  {
    digitalWrite(myClockPin, 0);

    //if the value passed to myDataOut and a bitmask result 
    // true then... so if we are at i=6 and our value is
    // %11010100 it would the code compares it to %01000000 
    // and proceeds to set pinState to 1.
    if ( myDataOut & (1<<i) ) {
      pinState= 1;
    }
    else {	
      pinState= 0;
    }

    //Sets the pin to HIGH or LOW depending on pinState
    digitalWrite(myDataPin, pinState);
    //register shifts bits on upstroke of clock pin  
    digitalWrite(myClockPin, 1);
    //zero the data pin after shift to prevent bleed through
    digitalWrite(myDataPin, 0);
  }

  //stop shifting
  digitalWrite(myClockPin, 0);
}


//blinks the whole register based on the number of times you want to 
//blink "n" and the pause between them "d"
//starts with a moment of darkness to make sure the first blink
//has its full visual effect.
void blinkAll_2Bytes(int n, int d) {
  digitalWrite(latchPin, 0);
  shiftOut(dataPin, clockPin, 0);
  shiftOut(dataPin, clockPin, 0);
  digitalWrite(latchPin, 1);
  delay(200);
  for (int x = 0; x < n; x++) {
    digitalWrite(latchPin, 0);
    shiftOut(dataPin, clockPin, 255);
    shiftOut(dataPin, clockPin, 255);
    digitalWrite(latchPin, 1);
    delay(d);
    digitalWrite(latchPin, 0);
    shiftOut(dataPin, clockPin, 0);
    shiftOut(dataPin, clockPin, 0);
    digitalWrite(latchPin, 1);
    delay(d);
  }
}
